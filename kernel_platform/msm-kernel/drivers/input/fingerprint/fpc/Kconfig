## kernel_platform/msm-kernel/drivers/input/fingerprint/fpc/Kconfig
```kconfig
config FPC_FINGERPRINT
        tristate "FPC Finger Print Driver"
        help
          PFC Finger Print Supported
```

## kernel_platform/msm-kernel/drivers/vendor/common/touchscreen_v2/focaltech_touch_3681_spi/Kconfig
```kconfig
#
# Focaltech Touchscreen driver configuration
#

config TOUCHSCREEN_FTS_3681_SPI
    bool "Focaltech Touchscreen"
    default n
    help
      Say Y here if you have Focaltech touch panel.
      If unsure, say N.

config TOUCHSCREEN_FTS_DIRECTORY
    string "Focaltech ts directory name"
    default "focaltech_touch"
    depends on TOUCHSCREEN_FTS_3681_SPI

config TOUCHSCREEN_FTS_SPI
    bool "Focaltech ts spi"
    default n
    depends on TOUCHSCREEN_FTS_3681_SPI

config TOUCHSCREEN_FTS_I2C
    bool "Focaltech ts i2c"
    default n
    depends on TOUCHSCREEN_FTS_3681_SPI
```
